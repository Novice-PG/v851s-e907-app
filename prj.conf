## CMakeLists.txt
```
# Copyright (c) 2026
# SPDX-License-Identifier: Apache-2.0

cmake_minimum_required(VERSION 3.28.0)

find_package(Zephyr REQUIRED HINTS $ENV{ZEPHYR_BASE})

project(v851s_e907_bringup)

target_sources(app PRIVATE
  src/main.c
  src/openamp_slave.c
  src/linkr_bridge.c
  src/board_early.c
)
```

## prj.conf
```kconfig
# Copyright (c) 2026
# SPDX-License-Identifier: Apache-2.0

# ELF name that the Linux remoteproc driver will look up in /lib/firmware.
CONFIG_KERNEL_BIN_NAME="zephyr_e907"

# UART3 is the Linkr Bee bridge port, so printk goes to the RAM console.
CONFIG_CONSOLE=y
CONFIG_PRINTK=y
CONFIG_UART_CONSOLE=n
CONFIG_RAM_CONSOLE=y
CONFIG_SERIAL=y
CONFIG_UART_NS16550=y
CONFIG_UART_INTERRUPT_DRIVEN=y
CONFIG_RING_BUFFER=y
# 64 KiB UART rings in linkr_bridge.c need the 32-bit index variant.
CONFIG_RING_BUFFER_LARGE=y

# The whole image runs from the DRAM window at 0x43c00000.
CONFIG_XIP=n

CONFIG_MAIN_STACK_SIZE=2048
CONFIG_HEAP_MEM_POOL_SIZE=1024

# MSGBOX transport (E907 side) for rpmsg/OpenAMP
CONFIG_MBOX=y
CONFIG_MBOX_SUNXI_MSGBOX=y
CONFIG_IPM=y
CONFIG_OPENAMP=y
CONFIG_OPENAMP_SLAVE=y
CONFIG_OPENAMP_MASTER=n

# Linux remoteproc resource table: one rpmsg vdev with two vrings and eight
# buffers per vring.  The generic table lets Linux fill in the vring
# addresses from the vdev0vring0/vdev0vring1 carveouts.
CONFIG_OPENAMP_RSC_TABLE=y
CONFIG_OPENAMP_RSC_TABLE_NUM_RPMSG_BUFF=8
CONFIG_OPENAMP_VRING_ALIGNMENT=16
```

## src/main.c
```c
/*
 * Copyright (c) 2026
 * SPDX-License-Identifier: Apache-2.0
 *
 * Minimal bring-up firmware for the V851S E907 co-processor.
 *
 * It is loaded by the A7-side Linux remoteproc driver into the reserved DRAM
 * window at 0x43c00000 (DA == PA, 4 MiB).  The console goes to the Zephyr
 * RAM console; UART3 is owned by the Linkr Bee bridge that forwards the
 * target console to the A7 over rpmsg.
 * A valid .resource_table section lets Linux remoteproc load and start it.
 */

#include <zephyr/kernel.h>
#include <zephyr/sys/printk.h>
#include <zephyr/version.h>

#include "linkr_bridge.h"

extern void e907_openamp_start(void);

int main(void)
{
	unsigned int n = 0;

	printk("\n");
	printk("*** YuzukiPI-Lizard V851S E907 co-processor ***\n");
	printk("Zephyr %s | RV32IMAC + xthead @ 600 MHz\n", KERNEL_VERSION_STRING);
	printk("CLINT 0x30000000 | CLIC 0x30800000 | UART3 0x02500c00\n");
	printk("firmware DRAM 0x43c00000 (4 MiB)\n");
	printk("rpmsg buffers 0x43000000, vrings 0x43040000 / 0x43060000\n");
	printk("resource table: 1 vdev + 2 vrings + RAM console trace\n");
	printk("mode: Linkr Bee UART3 bridge over rpmsg\n");
	printk("features: 64 KiB UART rings, LINKRCFG/LINKRSTAT, rpmsg chrdev\n");

	(void)linkr_bridge_init();
	e907_openamp_start();

	while (1) {
		printk("e907 heartbeat %u cyc %llu\n", n++,
		       (unsigned long long)k_cycle_get_64());
		k_msleep(30000);
	}

	return 0;
}
```

## src/board_early.c
```c
/*
 * Copyright (c) 2026
 * SPDX-License-Identifier: Apache-2.0
 *
 * Early E907 board init.  Kept as documentation of the UART3 pin-mux and
 * clock-gate values; the pin-mux itself is applied by the A7 (see below).
 *
 * IMPORTANT (verified on hardware, 2026-11-15): the E907 has NO bus access to
 * the PIO block (0x02000000).  A write to PE_CFG1 from this core is silently
 * ignored and the pin keeps reading func 0xf (io_disabled).  The pin-mux is
 * actually done by the A7, via uart3pin.ko (loaded by /usr/bin/start_e907
 * before the E907 is started).  The pin-mux write below is therefore a
 * defensive no-op and must not be relied upon; it is kept only to document
 * intent.  Whether the CCU clock-gate write (a different region, 0x02001000)
 * takes effect from the E907 has not been verified.
 *
 * Register values are taken from the vendor Linux 4.9 kernel drivers:
 *   - PIO base 0x02000000, bank spacing 0x30, CFG regs at +0x00
 *     (drivers/pinctrl/sunxi/pinctrl-sun8iw21p1.c, BANK_MEM_SIZE=0x30)
 *   - PE12 = uart3_tx, PE13 = uart3_rx, mux 7 (pinctrl-sun8iw21p1.c)
 *     PE bank = pin 128.. -> bank 4 -> 4*0x30 = 0xC0; pins 8..15 in CFG1
 *     at 0xC4; pin12 -> bits16..19, pin13 -> bits20..23 (byte at 0xC6).
 *   - UART3 clock gate: CCU (sunxi_clk_base = 0x02001000) + UART_GATE(0x090C)
 *     = 0x0200190C; enable bit 19, reset bit 3 (active-low: 1 = deassert)
 *     (drivers/clk/sunxi/clk-sun8iw21.c, clk-periph.c).
 *
 * NOTE: this is board-specific bring-up glue, not a general driver.
 */

#include <zephyr/kernel.h>
#include <zephyr/init.h>
#include <zephyr/sys/sys_io.h>

#define V851S_PIO_CFG_PE12_PE13   0x020000C4u  /* PE_CFG1 word (pins 8..15) */
#define V851S_CCU_UART_GATE       0x0200190Cu  /* UART_GATE: uart0..3 gates  */

#define PE12_PE13_MUX7            0x00770000u  /* bits16..19=7, bits20..23=7 */
#define UART3_GATE_EN             (1u << 19)   /* module clock enable        */
#define UART3_RESET_DEASSERT      (1u << 3)    /* reset is active-low        */

static int v851s_e907_uart3_early_init(void)
{
	uint32_t v;

	/* 1. Pin-mux PE12/PE13 -> UART3 (mux 7).  Only bits 16..23 are
	 *    touched, so pins 8..11 of the same CFG1 word are preserved.
	 */
	v = sys_read32(V851S_PIO_CFG_PE12_PE13);
	v = (v & ~PE12_PE13_MUX7) | PE12_PE13_MUX7;
	sys_write32(v, V851S_PIO_CFG_PE12_PE13);

	/* 2. Enable the UART3 clock gate and deassert its reset. */
	v = sys_read32(V851S_CCU_UART_GATE);
	v |= (UART3_GATE_EN | UART3_RESET_DEASSERT);
	sys_write32(v, V851S_CCU_UART_GATE);

	return 0;
}

/* Priority 0 runs before the ns16550/UART console driver (which inits at
 * CONFIG_SERIAL_INIT_PRIORITY, typically 50+), so the clock is on and the
 * pins muxed before the driver touches the UART3 registers.
 */
SYS_INIT(v851s_e907_uart3_early_init, PRE_KERNEL_1, 0);
```

## src/linkr_bridge.c
```c
/*
 * Copyright (c) 2026
 * SPDX-License-Identifier: Apache-2.0
 *
 * Linkr Bee UART <-> rpmsg bridge (E907 side).
 *
 * UART3 (PE12/PE13, 115200 8N1) is the serial port of the target board that
 * the browser terminal talks to.  Bytes received on UART3 are packed into
 * rpmsg messages towards the A7; bytes arriving over rpmsg are written to
 * UART3.  The A7 side runs the HTTP/WebSocket front-end and implements the
 * Linkr Bee session protocol.
 *
 * Protocol on the rpmsg endpoint:
 *   A7 -> E907  "LINKR1\n"   handshake, tells this side the A7 endpoint addr
 *   E907 -> A7  "LINKR1 OK\n" handshake reply
 *   afterwards  raw serial bytes in both directions
 *
 * Before the handshake the endpoint keeps the old echo behaviour so the
 * standalone rpmsg_test / rpmsg_bench tools still work.
 */

#include "linkr_bridge.h"

#include <zephyr/device.h>
#include <zephyr/drivers/uart.h>
#include <zephyr/kernel.h>
#include <zephyr/logging/log.h>
#include <zephyr/sys/ring_buffer.h>

#include <openamp/open_amp.h>

#include <string.h>
#include <stdlib.h>

LOG_MODULE_REGISTER(linkr_bridge, LOG_LEVEL_INF);

#define UART_NODE        DT_NODELABEL(uart3)
/* The E907 image uses ~57 KiB of its 4 MiB DRAM window, so the rings can be
 * generous without trade-offs: 64 KiB holds ~5.7 s at 115200, ~437 ms at
 * 1.5 Mbaud and ~164 ms at 4 Mbaud in each direction.  They are .bss, so the
 * extra 120 KiB costs no NAND space in the firmware file. */
#define RX_RING_SIZE     65536
#define TX_RING_SIZE     65536
#define RX_CHUNK         256
#define RX_POLL_MS       20

RING_BUF_DECLARE(uart_rx_ring, RX_RING_SIZE);
RING_BUF_DECLARE(uart_tx_ring, TX_RING_SIZE);

K_SEM_DEFINE(uart_rx_sem, 0, 1);
K_SEM_DEFINE(uart_tx_sem, 0, 1);
/* Signalled by the TX thread whenever it frees space in uart_tx_ring. */
K_SEM_DEFINE(uart_tx_space_sem, 0, 1);

/* Protects the RX ring: it is fed by the UART ISR and by the polling
 * fallback thread (used while the CLIC routing of UART3 is unproven). */
static struct k_spinlock rx_lock;

static const struct device *const uart_dev = DEVICE_DT_GET(UART_NODE);

static struct rpmsg_endpoint *bridge_ept;
static uint32_t bridge_dst;
static atomic_t bridge_ready;
static atomic_t uart_rx_total;
static atomic_t uart_rx_dropped;
static atomic_t uart_tx_dropped;

static void rx_push(const uint8_t *buf, uint32_t len)
{
	k_spinlock_key_t key;

	uint32_t put;

	if (!len) {
		return;
	}
	key = k_spin_lock(&rx_lock);
	put = ring_buf_put(&uart_rx_ring, buf, len);
	k_spin_unlock(&rx_lock, key);
	atomic_add(&uart_rx_total, put);
	if (put < len) {
		atomic_add(&uart_rx_dropped, len - put);
	}
}

static void uart_isr(const struct device *dev, void *user_data)
{
	uint8_t buf[64];

	ARG_UNUSED(user_data);

	uart_irq_update(dev);
	while (uart_irq_is_pending(dev)) {
		int n;

		if (!uart_irq_rx_ready(dev)) {
			break;
		}
		n = uart_fifo_read(dev, buf, sizeof(buf));
		if (n <= 0) {
			break;
		}
		rx_push(buf, (uint32_t)n);
	}
	k_sem_give(&uart_rx_sem);
}

/* Drain whatever is in the RX FIFO without waiting for an interrupt.
 *
 * The ns16550 driver does not serialise uart_fifo_read() between a thread and
 * its own ISR, so mask interrupts while the polling thread reads the FIFO.
 * (The ISR cannot be interrupted by the thread, so its own path needs no
 * lock.) */
static void uart_poll_rx(void)
{
	uint8_t buf[64];
	unsigned int key;
	int n;

	key = irq_lock();
	do {
		n = uart_fifo_read(uart_dev, buf, sizeof(buf));
		if (n > 0) {
			rx_push(buf, (uint32_t)n);
		}
	} while (n > 0);
	irq_unlock(key);
}

static void uart_rx_thread(void *a, void *b, void *c)
{
	uint8_t buf[RX_CHUNK];

	ARG_UNUSED(a);
	ARG_UNUSED(b);
	ARG_UNUSED(c);

	for (;;) {
		uint32_t got;

		/* Wait for the ISR, but also poll so a missing CLIC IRQ only
		 * costs latency instead of losing the bridge entirely. */
		(void)k_sem_take(&uart_rx_sem, K_MSEC(RX_POLL_MS));
		uart_poll_rx();

		while ((got = ring_buf_get(&uart_rx_ring, buf, sizeof(buf))) > 0) {
			if (!atomic_get(&bridge_ready) || !bridge_ept ||
			    bridge_dst == 0) {
				continue;
			}
			if (rpmsg_sendto(bridge_ept, buf, got, bridge_dst) < 0) {
				LOG_WRN("rpmsg tx failed, dropped %u bytes",
					(unsigned int)got);
			}
		}
	}
}

static void uart_tx_thread(void *a, void *b, void *c)
{
	uint8_t buf[RX_CHUNK];

	ARG_UNUSED(a);
	ARG_UNUSED(b);
	ARG_UNUSED(c);

	for (;;) {
		uint32_t got;

		k_sem_take(&uart_tx_sem, K_FOREVER);
		while ((got = ring_buf_get(&uart_tx_ring, buf, sizeof(buf))) > 0) {
			for (uint32_t i = 0; i < got; i++) {
				uart_poll_out(uart_dev, buf[i]);
			}
			/* Wake a producer that is waiting for ring space. */
			k_sem_give(&uart_tx_space_sem);
		}
	}
}

K_THREAD_STACK_DEFINE(uart_rx_stack, 1536);
K_THREAD_STACK_DEFINE(uart_tx_stack, 1536);
static struct k_thread uart_rx_thread_data;
static struct k_thread uart_tx_thread_data;

static bool handshake_match(const uint8_t *data, size_t len)
{
	return (len == 7 && !memcmp(data, "LINKR1\n", 7)) ||
	       (len == 6 && !memcmp(data, "LINKR1", 6));
}

/* ---- UART configuration control lines ----------------------------------
 * The A7 may ask this side to reprogram UART3 at runtime:
 *
 *   A7 -> E907  "LINKRCFG <baud>,<data>,<parity>,<stop>,<flow>\n"
 *               data: 5..8, parity: n|e|o, stop: 1|2, flow: n|rtscts
 *   E907 -> A7  "LINKRCFG OK uart=<baud>,<data>,<parity>,<stop>,<flow>\n"
 *              "LINKRCFG ERR=<errno>\n"
 *
 * The control line is consumed here and never written to UART3, so the
 * target board does not see it.  The reply travels back over the same
 * rpmsg endpoint; the A7 daemon strips it from the serial stream.
 */
#define LINKRCFG_PREFIX "LINKRCFG "
#define LINKRCFG_PREFIX_LEN (sizeof(LINKRCFG_PREFIX) - 1)

static const char *uart_data_name(enum uart_config_data_bits bits)
{
	switch (bits) {
	case UART_CFG_DATA_BITS_5:
		return "5";
	case UART_CFG_DATA_BITS_6:
		return "6";
	case UART_CFG_DATA_BITS_7:
		return "7";
	case UART_CFG_DATA_BITS_8:
	default:
		return "8";
	}
}

static const char *uart_parity_name(enum uart_config_parity parity)
{
	switch (parity) {
	case UART_CFG_PARITY_ODD:
		return "o";
	case UART_CFG_PARITY_EVEN:
		return "e";
	case UART_CFG_PARITY_NONE:
	default:
		return "n";
	}
}

static const char *uart_stop_name(enum uart_config_stop_bits stop)
{
	return stop == UART_CFG_STOP_BITS_2 ? "2" : "1";
}

static const char *uart_flow_name(enum uart_config_flow_control flow)
{
	return flow == UART_CFG_FLOW_CTRL_RTS_CTS ? "rtscts" : "n";
}

/* Last configuration successfully programmed on UART3.  The DT default is
 * 115200 8N1 without flow control; `LINKRCFG ?` reports this. */
static struct uart_config active_cfg = {
	.baudrate = 115200,
	.parity = UART_CFG_PARITY_NONE,
	.stop_bits = UART_CFG_STOP_BITS_1,
	.data_bits = UART_CFG_DATA_BITS_8,
	.flow_ctrl = UART_CFG_FLOW_CTRL_NONE,
};

static int cfg_reply(char *reply, size_t reply_len, const char *prefix)
{
	return snprintk(reply, reply_len, "%s uart=%u,%s,%s,%s,%s\n",
			prefix, active_cfg.baudrate,
			uart_data_name(active_cfg.data_bits),
			uart_parity_name(active_cfg.parity),
			uart_stop_name(active_cfg.stop_bits),
			uart_flow_name(active_cfg.flow_ctrl));
}

/* Split a comma separated token list in place.  Returns token count. */
static int split_commas(char *text, char **out, int max)
{
	int n = 0;

	while (n < max) {
		out[n++] = text;
		while (*text && *text != ',') {
			text++;
		}
		if (!*text) {
			break;
		}
		*text++ = '\0';
	}
	return n;
}

static int linkr_apply_cfg(char *args, char *reply, size_t reply_len)
{
	char *tok[5];
	struct uart_config cfg;
	unsigned long baud;
	int ntok;
	int ret;

	if (!strcmp(args, "?")) {
		return cfg_reply(reply, reply_len, "LINKRCFG OK");
	}

	ntok = split_commas(args, tok, 5);

	if (ntok != 5) {
		return snprintk(reply, reply_len, "LINKRCFG ERR=-22\n");
	}

	{
		char *end = NULL;

		baud = strtoul(tok[0], &end, 10);
		if (end == tok[0] || *end != '\0' ||
		    baud < 300 || baud > 4000000) {
			return snprintk(reply, reply_len, "LINKRCFG ERR=-22\n");
		}
	}

	cfg.baudrate = (uint32_t)baud;

	switch (tok[1][0]) {
	case '5':
		cfg.data_bits = UART_CFG_DATA_BITS_5;
		break;
	case '6':
		cfg.data_bits = UART_CFG_DATA_BITS_6;
		break;
	case '7':
		cfg.data_bits = UART_CFG_DATA_BITS_7;
		break;
	case '8':
		cfg.data_bits = UART_CFG_DATA_BITS_8;
		break;
	default:
		return snprintk(reply, reply_len, "LINKRCFG ERR=-22\n");
	}

	switch (tok[2][0]) {
	case 'n':
	case 'N':
		cfg.parity = UART_CFG_PARITY_NONE;
		break;
	case 'e':
	case 'E':
		cfg.parity = UART_CFG_PARITY_EVEN;
		break;
	case 'o':
	case 'O':
		cfg.parity = UART_CFG_PARITY_ODD;
		break;
	default:
		return snprintk(reply, reply_len, "LINKRCFG ERR=-22\n");
	}

	switch (tok[3][0]) {
	case '1':
		cfg.stop_bits = UART_CFG_STOP_BITS_1;
		break;
	case '2':
		cfg.stop_bits = UART_CFG_STOP_BITS_2;
		break;
	default:
		return snprintk(reply, reply_len, "LINKRCFG ERR=-22\n");
	}

	if (!strcmp(tok[4], "n") || !strcmp(tok[4], "none") ||
	    !strcmp(tok[4], "0")) {
		cfg.flow_ctrl = UART_CFG_FLOW_CTRL_NONE;
	} else if (!strcmp(tok[4], "rtscts") || !strcmp(tok[4], "r") ||
		   !strcmp(tok[4], "1")) {
		cfg.flow_ctrl = UART_CFG_FLOW_CTRL_RTS_CTS;
	} else {
		return snprintk(reply, reply_len, "LINKRCFG ERR=-22\n");
	}

	LOG_INF("reconfiguring UART3: %lu %s%s%s flow=%s", baud, tok[1],
		tok[2], tok[3], tok[4]);
	ret = uart_configure(uart_dev, &cfg);
	if (ret < 0) {
		LOG_WRN("uart_configure failed: %d", ret);
		return snprintk(reply, reply_len, "LINKRCFG ERR=%d\n", ret);
	}

	/* uart_configure() programs the port directly and leaves the
	 * interrupt enable register cleared; the polling thread would still
	 * drain RX, but re-enable the IRQ path for low latency. */
	uart_irq_rx_disable(uart_dev);
	uart_irq_callback_set(uart_dev, uart_isr);
	uart_irq_rx_enable(uart_dev);

	active_cfg = cfg;
	return cfg_reply(reply, reply_len, "LINKRCFG OK");
}

int linkr_bridge_rpmsg_recv(struct rpmsg_endpoint *ept, const void *data,
			    size_t len, uint32_t src)
{
	const uint8_t *p = data;
	uint32_t put;

	if (!ept || !data) {
		return -EINVAL;
	}

	bridge_ept = ept;
	bridge_dst = src;

	if (handshake_match(p, len)) {
		char reply[128];
		int n;

		atomic_set(&bridge_ready, 1);
		n = snprintk(reply, sizeof(reply), "LINKR1 OK rx=%u\n",
			     (unsigned int)atomic_get(&uart_rx_total));
		if (atomic_get(&uart_rx_dropped)) {
			LOG_WRN("%u UART RX bytes dropped (ring full)",
				(unsigned int)atomic_get(&uart_rx_dropped));
		}
		LOG_INF("A7 handshake from addr 0x%x, uart rx=%u", src,
			(unsigned int)atomic_get(&uart_rx_total));
		if (n < 0) {
			n = sizeof("LINKR1 OK\n") - 1;
			memcpy(reply, "LINKR1 OK\n", n);
		}
		return rpmsg_sendto(ept, reply, n, src);
	}

	/* "LINKRSTAT\n" reports the current ring occupancy and drop counters so
	 * the A7 can show real numbers in @i? instead of constants. */
	if (atomic_get(&bridge_ready) &&
	    ((len == 10 && !memcmp(p, "LINKRSTAT\n", 10)) ||
	     (len == 9 && !memcmp(p, "LINKRSTAT", 9)))) {
		char reply[128];
		int n = snprintk(reply, sizeof(reply),
				 "LINKRSTAT rx=%u/%u tx=%u/%u drop=%u/%u\n",
				 (unsigned int)ring_buf_size_get(&uart_rx_ring),
				 (unsigned int)RX_RING_SIZE,
				 (unsigned int)ring_buf_size_get(&uart_tx_ring),
				 (unsigned int)TX_RING_SIZE,
				 (unsigned int)atomic_get(&uart_rx_dropped),
				 (unsigned int)atomic_get(&uart_tx_dropped));

		if (n < 0) {
			return n;
		}
		return rpmsg_sendto(ept, reply, n, src);
	}

	if (atomic_get(&bridge_ready) && len > LINKRCFG_PREFIX_LEN &&
	    !memcmp(p, LINKRCFG_PREFIX, LINKRCFG_PREFIX_LEN)) {
		char line[96];
		char reply[96];
		size_t copy = len - LINKRCFG_PREFIX_LEN;
		int n;

		if (copy > sizeof(line) - 1) {
			copy = sizeof(line) - 1;
		}
		memcpy(line, p + LINKRCFG_PREFIX_LEN, copy);
		line[copy] = '\0';
		/* Trim the trailing newline the A7 adds. */
		while (copy > 0 && (line[copy - 1] == '\n' ||
				    line[copy - 1] == '\r')) {
			line[--copy] = '\0';
		}
		n = linkr_apply_cfg(line, reply, sizeof(reply));
		if (n < 0) {
			n = sizeof("LINKRCFG ERR=-5\n") - 1;
			memcpy(reply, "LINKRCFG ERR=-5\n", n);
		}
		return rpmsg_sendto(ept, reply, n, src);
	}

	if (!atomic_get(&bridge_ready)) {
		/* Legacy echo mode: keeps rpmsg_test / rpmsg_bench usable. */
		return rpmsg_sendto(ept, data, len, src);
	}

	put = ring_buf_put(&uart_tx_ring, p, len);
	if (put < len) {
		/* The line is 115200 baud: 100 KB takes ~9 s to leave the
		 * wire. Rather than silently dropping a paste, apply
		 * backpressure: block this endpoint's RX callback until the
		 * TX thread has drained some of the ring. That in turn stops
		 * the A7 from writing more rpmsg messages, and the browser
		 * sees the write slow down instead of losing data. Bound the
		 * wait so a wedged UART cannot hang the rpmsg endpoint.
		 */
		uint32_t left = len - put;

		p += put;
		while (left > 0) {
			if (k_sem_take(&uart_tx_space_sem, K_MSEC(100)) != 0) {
				LOG_WRN("UART TX stalled, dropped %u bytes",
					(unsigned int)left);
				atomic_add(&uart_tx_dropped, left);
				break;
			}
			put = ring_buf_put(&uart_tx_ring, p, left);
			p += put;
			left -= put;
		}
	}
	k_sem_give(&uart_tx_sem);

	return 0;
}

void linkr_bridge_rpmsg_unbind(struct rpmsg_endpoint *ept)
{
	if (bridge_ept == ept) {
		bridge_ept = NULL;
		bridge_dst = 0;
		atomic_set(&bridge_ready, 0);
	}
}

int linkr_bridge_init(void)
{
	uint8_t drain[64];

	if (!device_is_ready(uart_dev)) {
		LOG_ERR("UART3 not ready");
		return -ENODEV;
	}

	uart_irq_rx_disable(uart_dev);
	/* Flush anything the bootloader/console left behind. */
	while (uart_fifo_read(uart_dev, drain, sizeof(drain)) > 0) {
	}

	k_thread_create(&uart_rx_thread_data, uart_rx_stack,
			K_THREAD_STACK_SIZEOF(uart_rx_stack),
			uart_rx_thread, NULL, NULL, NULL,
			K_PRIO_PREEMPT(7), 0, K_NO_WAIT);
	k_thread_name_set(&uart_rx_thread_data, "uart_rx");

	k_thread_create(&uart_tx_thread_data, uart_tx_stack,
			K_THREAD_STACK_SIZEOF(uart_tx_stack),
			uart_tx_thread, NULL, NULL, NULL,
			K_PRIO_PREEMPT(8), 0, K_NO_WAIT);
	k_thread_name_set(&uart_tx_thread_data, "uart_tx");

	uart_irq_callback_set(uart_dev, uart_isr);
	uart_irq_rx_enable(uart_dev);

	LOG_INF("Linkr Bee bridge ready on %s", uart_dev->name);
	return 0;
}
```

## src/linkr_bridge.h
```c
/*
 * Copyright (c) 2026
 * SPDX-License-Identifier: Apache-2.0
 */

#ifndef LINKR_BRIDGE_H_
#define LINKR_BRIDGE_H_

#include <stddef.h>
#include <stdint.h>

#include <openamp/open_amp.h>

/** Start the UART3 threads and enable RX. Call once at boot. */
int linkr_bridge_init(void);

/**
 * Feed one rpmsg message into the bridge.
 *
 * Returns 0 on success, or a negative errno.  Before the "LINKR1" handshake
 * the message is echoed back, which keeps the standalone rpmsg test tools
 * working.
 */
int linkr_bridge_rpmsg_recv(struct rpmsg_endpoint *ept, const void *data,
			    size_t len, uint32_t src);

/**
 * Forget the endpoint that was used for the bridge.
 *
 * Called when the A7 tears its channel down so that we never send to a
 * destroyed endpoint.  The next handshake re-arms the bridge.
 */
void linkr_bridge_rpmsg_unbind(struct rpmsg_endpoint *ept);

#endif /* LINKR_BRIDGE_H_ */
```

## src/openamp_slave.c
```c
/*
 * Copyright (c) 2026
 * SPDX-License-Identifier: Apache-2.0
 *
 * OpenAMP rpmsg endpoint on the E907 (virtio device / remote side).
 *
 * Linux remoteproc reads the .resource_table built by
 * CONFIG_OPENAMP_RSC_TABLE, fills the vring addresses from the
 * vdev0vring0/vdev0vring1 carveouts and copies the table back into this
 * image before it starts the core.  rpmsg buffers come from the
 * vdev0buffer carveout at 0x43000000.
 *
 * The remote announces an rpmsg endpoint named "rpmsg_chrdev"; the A7
 * creates /dev/rpmsg_ctrl0 from it.  Endpoints created by the A7 are kept
 * in a small pool so a client reconnect never clobbers a live endpoint.
 * Messages are handed to the Linkr Bee UART bridge (linkr_bridge.c);
 * before the A7 handshake they are echoed back so the standalone rpmsg
 * test tools keep working.
 *
 * Kick/notify goes over the V851S MSGBOX via the IPM device (ipm0).
 */

#include <zephyr/kernel.h>
#include <zephyr/device.h>
#include <zephyr/drivers/ipm.h>
#include <zephyr/logging/log.h>

#include <metal/io.h>
#include <metal/device.h>
#include <openamp/open_amp.h>
#include <resource_table.h>

#include "linkr_bridge.h"

LOG_MODULE_REGISTER(e907_openamp, LOG_LEVEL_INF);

#define SHM_NODE	DT_CHOSEN(zephyr_ipc_shm)
#define SHM_START_ADDR	DT_REG_ADDR(SHM_NODE)
#define SHM_SIZE	DT_REG_SIZE(SHM_NODE)

/* One slot per channel the A7 announces back to us (each /dev/rpmsgN open). */
#define LINKR_MAX_EPTS	4

static const struct device *const ipm_dev = DEVICE_DT_GET(DT_CHOSEN(zephyr_ipc));

static struct metal_io_region shm_io;
static struct metal_io_region rsc_io;
static metal_phys_addr_t shm_physmap = SHM_START_ADDR;
static metal_phys_addr_t rsc_physmap;

static struct rpmsg_virtio_device rvdev;
static struct rpmsg_endpoint ns_ept;
static struct rpmsg_endpoint linkr_epts[LINKR_MAX_EPTS];
static bool linkr_ept_used[LINKR_MAX_EPTS];

K_MSGQ_DEFINE(ipm_msgq, sizeof(uint32_t), 8, 4);
/* Set when the queue is full: the RX thread then rescans both vrings, so a
 * dropped notification costs a little work instead of a stalled virtqueue. */
static atomic_t ipm_overflow;

/* --- rpmsg endpoint: Linkr Bee UART bridge --- */

static int bridge_cb(struct rpmsg_endpoint *ept, void *data, size_t len,
		     uint32_t src, void *priv)
{
	ARG_UNUSED(priv);

	return linkr_bridge_rpmsg_recv(ept, data, len, src);
}

static void linkr_ept_unbind(struct rpmsg_endpoint *ept)
{
	LOG_INF("rpmsg NS unbind addr 0x%x", ept->addr);

	linkr_bridge_rpmsg_unbind(ept);
	rpmsg_destroy_ept(ept);
	linkr_ept_used[ept - linkr_epts] = false;
}

static struct rpmsg_endpoint *linkr_ept_alloc(void)
{
	for (int i = 0; i < LINKR_MAX_EPTS; i++) {
		if (!linkr_ept_used[i]) {
			return &linkr_epts[i];
		}
	}

	return NULL;
}

static void ns_bind_cb(struct rpmsg_device *rdev, const char *name,
		       uint32_t dest)
{
	struct rpmsg_endpoint *ept = linkr_ept_alloc();
	int ret;

	LOG_INF("rpmsg NS bind: '%s' dest=%u", name, dest);

	if (ept == NULL) {
		LOG_ERR("no free endpoint slot for '%s'", name);
		return;
	}

	ret = rpmsg_create_ept(ept, rdev, name, RPMSG_ADDR_ANY, dest,
			       bridge_cb, linkr_ept_unbind);
	if (ret != 0) {
		LOG_ERR("rpmsg_create_ept('%s') failed: %d", name, ret);
		return;
	}

	linkr_ept_used[ept - linkr_epts] = true;
}

/* --- IPM: A7 kicks a virtqueue --- */

static int mailbox_notify(void *priv, uint32_t id)
{
	/* The A7 mbox callback reads the payload as the vring notifyid.  Keep it
	 * in static storage: the sunxi mailbox copies it into the data register
	 * synchronously, but a driver that defers the transfer must not get a
	 * pointer into this stack frame. */
	static uint32_t notify_id;

	ARG_UNUSED(priv);
	notify_id = id;
	return ipm_send(ipm_dev, 0, id, &notify_id, sizeof(notify_id));
}

static void ipm_rx_cb(const struct device *dev, void *ctx, uint32_t id,
		      volatile void *data)
{
	uint32_t notifyid = VRING1_ID;

	ARG_UNUSED(dev);
	ARG_UNUSED(ctx);
	ARG_UNUSED(id);

	if (data != NULL) {
		notifyid = *(volatile uint32_t *)data;
	}

	/* ISR context: defer rpmsg processing to the RX thread.  A full queue
	 * must not lose the kick: mark it and let the thread rescan. */
	if (k_msgq_put(&ipm_msgq, &notifyid, K_NO_WAIT) != 0) {
		atomic_set(&ipm_overflow, 1);
	}
}

static void ipm_rx_thread(void *a, void *b, void *c)
{
	uint32_t notifyid;

	ARG_UNUSED(a);
	ARG_UNUSED(b);
	ARG_UNUSED(c);

	for (;;) {
		if (k_msgq_get(&ipm_msgq, &notifyid, K_FOREVER) != 0) {
			continue;
		}

		do {
			(void)rproc_virtio_notified(rvdev.vdev, notifyid);
		} while (k_msgq_get(&ipm_msgq, &notifyid, K_NO_WAIT) == 0);

		if (atomic_cas(&ipm_overflow, 1, 0)) {
			/* At least one kick was dropped while the queue was
			 * full; draining both vrings is cheap and restores
			 * progress. */
			(void)rproc_virtio_notified(rvdev.vdev, VRING0_ID);
			(void)rproc_virtio_notified(rvdev.vdev, VRING1_ID);
		}
	}
}

K_THREAD_STACK_DEFINE(ipm_rx_stack, 4096);
static struct k_thread ipm_rx_thread_data;

/* --- bring-up --- */

static int openamp_slave_init(void)
{
	struct metal_init_params metal_params = METAL_INIT_DEFAULTS;
	struct fw_rsc_vdev_vring *vring_rsc;
	struct virtio_device *vdev;
	void *rsc_table;
	int rsc_size;
	int ret;

	ret = metal_init(&metal_params);
	if (ret != 0) {
		LOG_ERR("metal_init failed: %d", ret);
		return ret;
	}

	/* Shared memory window (DA == PA) covering buffers and both vrings. */
	metal_io_init(&shm_io, (void *)SHM_START_ADDR, &shm_physmap,
		      SHM_SIZE, -1, 0, NULL);

	/* The resource table is in this image and is updated by Linux. */
	rsc_table_get(&rsc_table, &rsc_size);
	rsc_physmap = (metal_phys_addr_t)(uintptr_t)rsc_table;
	metal_io_init(&rsc_io, rsc_table, &rsc_physmap, rsc_size, -1, 0, NULL);

	vdev = rproc_virtio_create_vdev(VIRTIO_DEV_DEVICE, VDEV_ID,
					rsc_table_to_vdev(rsc_table), &rsc_io,
					NULL, mailbox_notify, NULL);
	if (vdev == NULL) {
		LOG_ERR("failed to create vdev");
		return -ENODEV;
	}

	/* Wait until Linux has set DRIVER_OK in the resource table. */
	rproc_virtio_wait_remote_ready(vdev);

	vring_rsc = rsc_table_get_vring0(rsc_table);
	ret = rproc_virtio_init_vring(vdev, 0, vring_rsc->notifyid,
				      (void *)(uintptr_t)vring_rsc->da, &shm_io,
				      vring_rsc->num, vring_rsc->align);
	if (ret != 0) {
		LOG_ERR("failed to init vring 0: %d", ret);
		goto failed;
	}

	vring_rsc = rsc_table_get_vring1(rsc_table);
	ret = rproc_virtio_init_vring(vdev, 1, vring_rsc->notifyid,
				      (void *)(uintptr_t)vring_rsc->da, &shm_io,
				      vring_rsc->num, vring_rsc->align);
	if (ret != 0) {
		LOG_ERR("failed to init vring 1: %d", ret);
		goto failed;
	}

	ret = rpmsg_init_vdev(&rvdev, vdev, ns_bind_cb, &shm_io, NULL);
	if (ret != 0) {
		LOG_ERR("rpmsg_init_vdev failed: %d", ret);
		goto failed;
	}

	/* Only enable the MSGBOX/IPM RX interrupt once the vrings exist. */
	ipm_register_callback(ipm_dev, ipm_rx_cb, NULL);
	ipm_set_enabled(ipm_dev, 1);

	/* Announce the channel once; the A7 answers with an NS bind. */
	ret = rpmsg_create_ept(&ns_ept, &rvdev.rdev, "rpmsg_chrdev",
			       RPMSG_ADDR_ANY, RPMSG_ADDR_ANY, bridge_cb, NULL);
	if (ret != 0) {
		LOG_ERR("rpmsg_create_ept(rpmsg_chrdev) failed: %d", ret);
		goto failed;
	}

	LOG_INF("OpenAMP rpmsg_chrdev ready (addr 0x%x)", ns_ept.addr);
	return 0;

failed:
	rproc_virtio_remove_vdev(vdev);
	return ret;
}

static K_THREAD_STACK_DEFINE(openamp_stack, 4096);
static struct k_thread openamp_thread;

static void openamp_thread_fn(void *a, void *b, void *c)
{
	ARG_UNUSED(a);
	ARG_UNUSED(b);
	ARG_UNUSED(c);

	if (openamp_slave_init() != 0) {
		return;
	}

	k_thread_create(&ipm_rx_thread_data, ipm_rx_stack,
			K_THREAD_STACK_SIZEOF(ipm_rx_stack),
			ipm_rx_thread, NULL, NULL, NULL,
			K_PRIO_PREEMPT(6), 0, K_NO_WAIT);
	k_thread_name_set(&ipm_rx_thread_data, "openamp_rx");
}

void e907_openamp_start(void)
{
	k_thread_create(&openamp_thread, openamp_stack,
			K_THREAD_STACK_SIZEOF(openamp_stack),
			openamp_thread_fn, NULL, NULL, NULL,
			K_PRIO_PREEMPT(6), 0, K_NO_WAIT);
	k_thread_name_set(&openamp_thread, "openamp");
}
```
